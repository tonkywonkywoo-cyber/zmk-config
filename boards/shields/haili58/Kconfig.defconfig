## boards/shields/haili58/Kconfig.defconfig
```kconfig
if SHIELD_HAILI58_LEFT

# Name must be less than 16 characters long!
config ZMK_KEYBOARD_NAME
    default "haili58"

config ZMK_SPLIT_ROLE_CENTRAL
    default y

endif

if SHIELD_HAILI58_LEFT || SHIELD_HAILI58_RIGHT

config ZMK_SPLIT
    default y

endif

if ZMK_DISPLAY

config I2C
    default y

config SSD1306
    default y

choice ZMK_DISPLAY_WORK_QUEUE
    default ZMK_DISPLAY_WORK_QUEUE_DEDICATED
endchoice

endif

if LVGL

config LV_Z_VDB_SIZE
    default 64

config LV_DPI_DEF
    default 148

config LV_Z_BITS_PER_PIXEL
    default 1

choice LV_COLOR_DEPTH
    default LV_COLOR_DEPTH_1
endchoice

endif 
```

## boards/shields/haili58/Kconfig.shield
```kconfig
config SHIELD_HAILI58_LEFT
    def_bool $(shields_list_contains,haili58_left)
  
config SHIELD_HAILI58_RIGHT
    def_bool $(shields_list_contains,haili58_right)
```
